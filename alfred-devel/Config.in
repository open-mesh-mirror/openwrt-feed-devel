## alfred-devel/Config.in
```kconfig
config ALFRED_DEVEL_NEEDS_lua
	bool

config ALFRED_DEVEL_NEEDS_libgps
	bool

config PACKAGE_ALFRED_DEVEL_VIS
	bool "enable vis server for alfred"
	depends on PACKAGE_alfred-devel
	default y

config PACKAGE_ALFRED_DEVEL_BATHOSTS
	bool "enable autogeneration of /etc/bat-hosts"
	depends on PACKAGE_alfred-devel
	select ALFRED_DEVEL_NEEDS_lua
	default n

config PACKAGE_ALFRED_DEVEL_GPSD
	bool "enable gpsd service for alfred"
	depends on PACKAGE_alfred-devel
	select ALFRED_DEVEL_NEEDS_libgps
	default n

config ALFRED_DEVEL_ALFRED_BRANCH
        string
        prompt "alfred branch to build package with"
        depends on PACKAGE_alfred-devel
        default "master"
        help
                Enter an alfred branch name or git tag to override package
                default value. This allows to build from non-master branches
                to test unreleased features.
```

## batctl-devel/Config.in
```kconfig
config BATCTL_DEVEL_BATCTL_BRANCH
	string
	prompt "batctl branch to build package with"
	depends on PACKAGE_batctl-devel
	default "master"
	help
	  Enter a batctl branch name or git tag to override package
	  default value. This allows to build from non-master branches
	  to test unreleased features.
```

## batman-adv-devel/Config.in
```kconfig
config KMOD_BATMAN_ADV_DEVEL_BATMAN_V
	bool "enable batman v routing algorithm"
	depends on PACKAGE_kmod-batman-adv-devel
	default y

config KMOD_BATMAN_ADV_DEVEL_BLA
	bool "enable bridge loop avoidance"
	depends on PACKAGE_kmod-batman-adv-devel
	default y

config KMOD_BATMAN_ADV_DEVEL_DAT
	bool "enable distributed arp table"
	depends on PACKAGE_kmod-batman-adv-devel
	default y

config KMOD_BATMAN_ADV_DEVEL_NC
	bool "enable network coding [requires promisc mode support]"
	depends on PACKAGE_kmod-batman-adv-devel
	default n

config KMOD_BATMAN_ADV_DEVEL_MCAST
	bool "enable multicast transmission optimization"
	depends on PACKAGE_kmod-batman-adv-devel

config KMOD_BATMAN_ADV_DEVEL_DEBUGFS
	bool "enable debugfs support"
	depends on PACKAGE_kmod-batman-adv-devel
	default n

config KMOD_BATMAN_ADV_DEVEL_DEBUG_LOG
	bool "enable verbose debug logging"
	depends on PACKAGE_kmod-batman-adv-devel
	depends on KMOD_BATMAN_ADV_DEVEL_DEBUGFS
	default n
```
